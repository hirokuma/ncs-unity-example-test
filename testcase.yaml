## testcase.yaml
```yaml
tests:
  unity.example_test:
    tags: example
    integration_platforms:
      - native_posix_64
    platform_allow:
      - native_posix_64
```

## tests/foo/testcase.yaml
```yaml
tests:
  unity.foo_test:
    tags: foo_test
    integration_platforms:
      - native_sim_64
    platform_allow:
      - native_sim_64
```

## tests/uut/testcase.yaml
```yaml
tests:
  unity.uut_test:
    tags: uut_test
    integration_platforms:
      - native_sim_64
    platform_allow:
      - native_sim_64
```
